## conf/layer.conf
```bitbake
# We have a conf and classes directory, add to BBPATH
BBPATH .= ":${LAYERDIR}"

# We have a packages directory, add to BBFILES
BBFILES += "${LAYERDIR}/recipes-*/*/*.bb \
            ${LAYERDIR}/recipes-*/*/*.bbappend"

BBFILE_COLLECTIONS += "wandboard-ap"
BBFILE_PATTERN_wandboard-ap := "^${LAYERDIR}/"
BBFILE_PRIORITY_wandboard-ap = "6"
```
